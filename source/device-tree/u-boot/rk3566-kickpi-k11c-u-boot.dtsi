// SPDX-License-Identifier: (GPL-2.0+ OR MIT)

/* Keep U-Boot-specific bootph policy separate from the shared Linux DTS. */
#include "rk356x-u-boot.dtsi"

/*
 * Do not let U-Boot probe the always-powered Wi-Fi SDIO host.
 * The compiled boot command restores this node to "okay" in the flat DT just
 * before EFI handoff, while U-Boot's already-created live tree stays disabled.
 */
&sdmmc1 {
	status = "disabled";
};

&{/cpus/cpu@0} { phandle = <0xa>; };
&{/cpus/cpu@100} { phandle = <0xb>; };
&{/cpus/cpu@200} { phandle = <0xc>; };
&{/cpus/cpu@300} { phandle = <0xd>; };
&{/l3-cache} { phandle = <0x3>; };
&{/display-subsystem} { phandle = <0xca>; };
&{/firmware/scmi} { phandle = <0xcb>; };
&{/firmware/scmi/protocol@14} { phandle = <0x2>; };
&{/hdmi-sound} { phandle = <0xcc>; };
&{/reserved-memory/shmem@10f000} { phandle = <0x7>; };
&{/reserved-memory/npu-dma-pool} { phandle = <0x267>; };
&{/xin24m} { phandle = <0x1d>; };
&{/xin32k} { phandle = <0xcd>; };
&{/sata@fc400000} { phandle = <0xce>; };
&{/sata@fc800000} { phandle = <0xcf>; };
&{/usb@fcc00000} { phandle = <0xd0>; };
&{/usb@fd000000} { phandle = <0xd1>; };
&{/interrupt-controller@fd400000} { phandle = <0x1>; };
&{/interrupt-controller@fd400000/msi-controller@fd440000} { phandle = <0x5e>; };
&{/usb@fd800000} { phandle = <0xd2>; };
&{/usb@fd840000} { phandle = <0xd3>; };
&{/usb@fd880000} { phandle = <0xd4>; };
&{/usb@fd8c0000} { phandle = <0xd5>; };
&{/syscon@fdc20000} { phandle = <0x5c>; };
&{/syscon@fdc20000/io-domains} { phandle = <0xd6>; };
&{/syscon@fdc50000} { phandle = <0xac>; };
&{/syscon@fdc60000} { phandle = <0x1f>; };
&{/syscon@fdc80000} { phandle = <0xad>; };
&{/syscon@fdc90000} { phandle = <0xae>; };
&{/syscon@fdca0000} { phandle = <0xaf>; };
&{/syscon@fdca8000} { phandle = <0xb2>; };
&{/clock-controller@fdd00000} { phandle = <0x1e>; };
&{/clock-controller@fdd20000} { phandle = <0xf>; };
&{/i2c@fdd40000} { phandle = <0xd7>; };
&{/i2c@fdd40000/regulator@1c} { phandle = <0x5>; };
&{/i2c@fdd40000/pmic@20} { phandle = <0xc1>; };
&{/i2c@fdd40000/pmic@20/regulators/DCDC_REG1} { phandle = <0xd8>; };
&{/i2c@fdd40000/pmic@20/regulators/DCDC_REG2} { phandle = <0x44>; };
&{/i2c@fdd40000/pmic@20/regulators/DCDC_REG3} { phandle = <0xd9>; };
&{/i2c@fdd40000/pmic@20/regulators/DCDC_REG4} { phandle = <0xda>; };
&{/i2c@fdd40000/pmic@20/regulators/DCDC_REG5} { phandle = <0x1b>; };
&{/i2c@fdd40000/pmic@20/regulators/LDO_REG1} { phandle = <0x58>; };
&{/i2c@fdd40000/pmic@20/regulators/LDO_REG2} { phandle = <0xdb>; };
&{/i2c@fdd40000/pmic@20/regulators/LDO_REG3} { phandle = <0xdc>; };
&{/i2c@fdd40000/pmic@20/regulators/LDO_REG4} { phandle = <0x19>; };
&{/i2c@fdd40000/pmic@20/regulators/LDO_REG5} { phandle = <0x1a>; };
&{/i2c@fdd40000/pmic@20/regulators/LDO_REG6} { phandle = <0xdd>; };
&{/i2c@fdd40000/pmic@20/regulators/LDO_REG7} { phandle = <0x9f>; };
&{/i2c@fdd40000/pmic@20/regulators/LDO_REG8} { phandle = <0x18>; };
&{/i2c@fdd40000/pmic@20/regulators/LDO_REG9} { phandle = <0x59>; };
&{/i2c@fdd40000/pmic@20/regulators/SWITCH_REG1} { phandle = <0x1c>; };
&{/i2c@fdd40000/pmic@20/regulators/SWITCH_REG2} { phandle = <0xde>; };
&{/serial@fdd50000} { phandle = <0xdf>; };
&{/pwm@fdd70000} { phandle = <0xe0>; };
&{/pwm@fdd70010} { phandle = <0xe1>; };
&{/pwm@fdd70020} { phandle = <0xe2>; };
&{/pwm@fdd70030} { phandle = <0xe3>; };
&{/power-management@fdd90000} { phandle = <0xe4>; };
&{/power-management@fdd90000/power-controller} { phandle = <0x11>; };
&{/gpu@fde60000} { phandle = <0x9c>; };
&{/video-codec@fdea0400} { phandle = <0xe5>; };
&{/iommu@fdea0800} { phandle = <0x45>; };
&{/rga@fdeb0000} { phandle = <0xe6>; };
&{/video-codec@fdee0000} { phandle = <0xe7>; };
&{/iommu@fdee0800} { phandle = <0x46>; };
&{/mmc@fe000000} { phandle = <0xe8>; };
&{/ethernet@fe010000} { phandle = <0xe9>; };
&{/ethernet@fe010000/mdio} { phandle = <0xea>; };
&{/ethernet@fe010000/mdio/ethernet-phy@0} { phandle = <0x4a>; };
&{/ethernet@fe010000/stmmac-axi-config} { phandle = <0x47>; };
&{/ethernet@fe010000/rx-queues-config} { phandle = <0x48>; };
&{/ethernet@fe010000/tx-queues-config} { phandle = <0x49>; };
&{/vop@fe040000} { phandle = <0xeb>; };
&{/vop@fe040000/ports} { phandle = <0x6>; };
&{/vop@fe040000/ports/port@0} { phandle = <0xec>; };
&{/vop@fe040000/ports/port@0/endpoint@2} { phandle = <0x5a>; };
&{/vop@fe040000/ports/port@1} { phandle = <0xed>; };
&{/vop@fe040000/ports/port@2} { phandle = <0xee>; };
&{/iommu@fe043e00} { phandle = <0x51>; };
&{/dsi@fe060000} { phandle = <0xef>; };
&{/dsi@fe060000/ports/port@0} { phandle = <0xf0>; };
&{/dsi@fe060000/ports/port@1} { phandle = <0xf1>; };
&{/dsi@fe070000} { phandle = <0xf2>; };
&{/dsi@fe070000/ports/port@0} { phandle = <0xf3>; };
&{/dsi@fe070000/ports/port@1} { phandle = <0xf4>; };
&{/hdmi@fe0a0000} { phandle = <0x8>; };
&{/hdmi@fe0a0000/ports/port@0} { phandle = <0xf5>; };
&{/hdmi@fe0a0000/ports/port@0/endpoint} { phandle = <0x52>; };
&{/hdmi@fe0a0000/ports/port@1} { phandle = <0xf6>; };
&{/hdmi@fe0a0000/ports/port@1/endpoint} { phandle = <0xbc>; };
&{/qos@fe128000} { phandle = <0x2c>; };
&{/qos@fe138080} { phandle = <0x3b>; };
&{/qos@fe138100} { phandle = <0x3c>; };
&{/qos@fe138180} { phandle = <0x3d>; };
&{/qos@fe148000} { phandle = <0x2d>; };
&{/qos@fe148080} { phandle = <0x2e>; };
&{/qos@fe148100} { phandle = <0x2f>; };
&{/qos@fe150000} { phandle = <0x39>; };
&{/qos@fe158000} { phandle = <0x33>; };
&{/qos@fe158100} { phandle = <0x34>; };
&{/qos@fe158180} { phandle = <0x35>; };
&{/qos@fe158200} { phandle = <0x36>; };
&{/qos@fe158280} { phandle = <0x37>; };
&{/qos@fe158300} { phandle = <0x38>; };
&{/qos@fe180000} { phandle = <0xf7>; };
&{/qos@fe190000} { phandle = <0x3e>; };
&{/qos@fe190280} { phandle = <0x3f>; };
&{/qos@fe190300} { phandle = <0x40>; };
&{/qos@fe190380} { phandle = <0x41>; };
&{/qos@fe190400} { phandle = <0x42>; };
&{/qos@fe198000} { phandle = <0x3a>; };
&{/qos@fe1a8000} { phandle = <0x30>; };
&{/qos@fe1a8080} { phandle = <0x31>; };
&{/qos@fe1a8100} { phandle = <0x32>; };
&{/dfi@fe230000} { phandle = <0xf8>; };
&{/pcie@fe260000} { phandle = <0xf9>; };
&{/pcie@fe260000/legacy-interrupt-controller} { phandle = <0x5d>; };
&{/mmc@fe2b0000} { phandle = <0xfa>; };
&{/mmc@fe2c0000} { phandle = <0xfb>; };
&{/spi@fe300000} { phandle = <0xfc>; };
&{/mmc@fe310000} { phandle = <0xfd>; };
&{/rng@fe388000} { phandle = <0xfe>; };
&{/i2s@fe400000} { phandle = <0x9>; };
&{/i2s@fe410000} { phandle = <0xc0>; };
&{/i2s@fe420000} { phandle = <0xff>; };
&{/i2s@fe430000} { phandle = <0x100>; };
&{/pdm@fe440000} { phandle = <0x101>; };
&{/spdif@fe460000} { phandle = <0x102>; };
&{/dma-controller@fe530000} { phandle = <0x26>; };
&{/dma-controller@fe550000} { phandle = <0x6f>; };
&{/i2c@fe5a0000} { phandle = <0x103>; };
&{/i2c@fe5b0000} { phandle = <0x104>; };
&{/i2c@fe5c0000} { phandle = <0x105>; };
&{/i2c@fe5d0000} { phandle = <0x106>; };
&{/i2c@fe5d0000/rtc@51} { phandle = <0x107>; };
&{/i2c@fe5e0000} { phandle = <0x108>; };
&{/watchdog@fe600000} { phandle = <0x109>; };
&{/spi@fe610000} { phandle = <0x10a>; };
&{/spi@fe620000} { phandle = <0x10b>; };
&{/spi@fe630000} { phandle = <0x10c>; };
&{/spi@fe640000} { phandle = <0x10d>; };
&{/serial@fe650000} { phandle = <0x10e>; };
&{/serial@fe660000} { phandle = <0x10f>; };
&{/serial@fe670000} { phandle = <0x110>; };
&{/serial@fe680000} { phandle = <0x111>; };
&{/serial@fe690000} { phandle = <0x112>; };
&{/serial@fe6a0000} { phandle = <0x113>; };
&{/serial@fe6b0000} { phandle = <0x114>; };
&{/serial@fe6c0000} { phandle = <0x115>; };
&{/serial@fe6d0000} { phandle = <0x116>; };
&{/thermal-zones} { phandle = <0x117>; };
&{/thermal-zones/cpu-thermal} { phandle = <0x118>; };
&{/thermal-zones/cpu-thermal/trips/cpu_alert0} { phandle = <0x9a>; };
&{/thermal-zones/cpu-thermal/trips/cpu_alert1} { phandle = <0x119>; };
&{/thermal-zones/cpu-thermal/trips/cpu_crit} { phandle = <0x11a>; };
&{/thermal-zones/gpu-thermal} { phandle = <0x11b>; };
&{/thermal-zones/gpu-thermal/trips/gpu-threshold} { phandle = <0x11c>; };
&{/thermal-zones/gpu-thermal/trips/gpu-target} { phandle = <0x9b>; };
&{/thermal-zones/gpu-thermal/trips/gpu-crit} { phandle = <0x11d>; };
&{/tsadc@fe710000} { phandle = <0x99>; };
&{/saradc@fe720000} { phandle = <0x11e>; };
&{/pwm@fe6e0000} { phandle = <0x11f>; };
&{/pwm@fe6e0010} { phandle = <0x120>; };
&{/pwm@fe6e0020} { phandle = <0x121>; };
&{/pwm@fe6e0030} { phandle = <0x122>; };
&{/pwm@fe6f0000} { phandle = <0x123>; };
&{/pwm@fe6f0010} { phandle = <0x124>; };
&{/pwm@fe6f0020} { phandle = <0x125>; };
&{/pwm@fe6f0030} { phandle = <0x126>; };
&{/pwm@fe700000} { phandle = <0x127>; };
&{/pwm@fe700010} { phandle = <0x128>; };
&{/pwm@fe700020} { phandle = <0x129>; };
&{/pwm@fe700030} { phandle = <0x12a>; };
&{/phy@fe830000} { phandle = <0x10>; };
&{/phy@fe840000} { phandle = <0x12>; };
&{/phy@fe870000} { phandle = <0x12b>; };
&{/mipi-dphy@fe850000} { phandle = <0x53>; };
&{/mipi-dphy@fe860000} { phandle = <0x54>; };
&{/usb2phy@fe8a0000} { phandle = <0x14>; };
&{/usb2phy@fe8a0000/host-port} { phandle = <0x15>; };
&{/usb2phy@fe8a0000/otg-port} { phandle = <0x13>; };
&{/usb2phy@fe8b0000} { phandle = <0x12c>; };
&{/usb2phy@fe8b0000/host-port} { phandle = <0x17>; };
&{/usb2phy@fe8b0000/otg-port} { phandle = <0x16>; };
&{/pinctrl} { phandle = <0xb3>; };
&{/pinctrl/gpio@fdd60000} { phandle = <0x22>; };
&{/pinctrl/gpio@fe740000} { phandle = <0x12d>; };
&{/pinctrl/gpio@fe750000} { phandle = <0x12e>; };
&{/pinctrl/gpio@fe760000} { phandle = <0xc3>; };
&{/pinctrl/gpio@fe770000} { phandle = <0x50>; };
&{/pinctrl/pcfg-pull-up} { phandle = <0xb6>; };
&{/pinctrl/pcfg-pull-down} { phandle = <0x12f>; };
&{/pinctrl/pcfg-pull-none} { phandle = <0xb4>; };
&{/pinctrl/pcfg-pull-none-drv-level-0} { phandle = <0x130>; };
&{/pinctrl/pcfg-pull-none-drv-level-1} { phandle = <0xb8>; };
&{/pinctrl/pcfg-pull-none-drv-level-2} { phandle = <0xb7>; };
&{/pinctrl/pcfg-pull-none-drv-level-3} { phandle = <0xbb>; };
&{/pinctrl/pcfg-pull-none-drv-level-4} { phandle = <0x131>; };
&{/pinctrl/pcfg-pull-none-drv-level-5} { phandle = <0x132>; };
&{/pinctrl/pcfg-pull-none-drv-level-6} { phandle = <0x133>; };
&{/pinctrl/pcfg-pull-none-drv-level-7} { phandle = <0x134>; };
&{/pinctrl/pcfg-pull-none-drv-level-8} { phandle = <0x135>; };
&{/pinctrl/pcfg-pull-none-drv-level-9} { phandle = <0x136>; };
&{/pinctrl/pcfg-pull-none-drv-level-10} { phandle = <0x137>; };
&{/pinctrl/pcfg-pull-none-drv-level-11} { phandle = <0x138>; };
&{/pinctrl/pcfg-pull-none-drv-level-12} { phandle = <0x139>; };
&{/pinctrl/pcfg-pull-none-drv-level-13} { phandle = <0x13a>; };
&{/pinctrl/pcfg-pull-none-drv-level-14} { phandle = <0x13b>; };
&{/pinctrl/pcfg-pull-none-drv-level-15} { phandle = <0x13c>; };
&{/pinctrl/pcfg-pull-up-drv-level-0} { phandle = <0x13d>; };
&{/pinctrl/pcfg-pull-up-drv-level-1} { phandle = <0xba>; };
&{/pinctrl/pcfg-pull-up-drv-level-2} { phandle = <0xb5>; };
&{/pinctrl/pcfg-pull-up-drv-level-3} { phandle = <0x13e>; };
&{/pinctrl/pcfg-pull-up-drv-level-4} { phandle = <0x13f>; };
&{/pinctrl/pcfg-pull-up-drv-level-5} { phandle = <0x140>; };
&{/pinctrl/pcfg-pull-up-drv-level-6} { phandle = <0x141>; };
&{/pinctrl/pcfg-pull-up-drv-level-7} { phandle = <0x142>; };
&{/pinctrl/pcfg-pull-up-drv-level-8} { phandle = <0x143>; };
&{/pinctrl/pcfg-pull-up-drv-level-9} { phandle = <0x144>; };
&{/pinctrl/pcfg-pull-up-drv-level-10} { phandle = <0x145>; };
&{/pinctrl/pcfg-pull-up-drv-level-11} { phandle = <0x146>; };
&{/pinctrl/pcfg-pull-up-drv-level-12} { phandle = <0x147>; };
&{/pinctrl/pcfg-pull-up-drv-level-13} { phandle = <0x148>; };
&{/pinctrl/pcfg-pull-up-drv-level-14} { phandle = <0x149>; };
&{/pinctrl/pcfg-pull-up-drv-level-15} { phandle = <0x14a>; };
&{/pinctrl/pcfg-pull-down-drv-level-0} { phandle = <0x14b>; };
&{/pinctrl/pcfg-pull-down-drv-level-1} { phandle = <0x14c>; };
&{/pinctrl/pcfg-pull-down-drv-level-2} { phandle = <0x14d>; };
&{/pinctrl/pcfg-pull-down-drv-level-3} { phandle = <0x14e>; };
&{/pinctrl/pcfg-pull-down-drv-level-4} { phandle = <0x14f>; };
&{/pinctrl/pcfg-pull-down-drv-level-5} { phandle = <0x150>; };
&{/pinctrl/pcfg-pull-down-drv-level-6} { phandle = <0x151>; };
&{/pinctrl/pcfg-pull-down-drv-level-7} { phandle = <0x152>; };
&{/pinctrl/pcfg-pull-down-drv-level-8} { phandle = <0x153>; };
&{/pinctrl/pcfg-pull-down-drv-level-9} { phandle = <0x154>; };
&{/pinctrl/pcfg-pull-down-drv-level-10} { phandle = <0x155>; };
&{/pinctrl/pcfg-pull-down-drv-level-11} { phandle = <0x156>; };
&{/pinctrl/pcfg-pull-down-drv-level-12} { phandle = <0x157>; };
&{/pinctrl/pcfg-pull-down-drv-level-13} { phandle = <0x158>; };
&{/pinctrl/pcfg-pull-down-drv-level-14} { phandle = <0x159>; };
&{/pinctrl/pcfg-pull-down-drv-level-15} { phandle = <0x15a>; };
&{/pinctrl/pcfg-pull-up-smt} { phandle = <0x15b>; };
&{/pinctrl/pcfg-pull-down-smt} { phandle = <0x15c>; };
&{/pinctrl/pcfg-pull-none-smt} { phandle = <0xb9>; };
&{/pinctrl/pcfg-pull-none-drv-level-0-smt} { phandle = <0x15d>; };
&{/pinctrl/pcfg-pull-none-drv-level-1-smt} { phandle = <0x15e>; };
&{/pinctrl/pcfg-pull-none-drv-level-2-smt} { phandle = <0x15f>; };
&{/pinctrl/pcfg-pull-none-drv-level-3-smt} { phandle = <0x160>; };
&{/pinctrl/pcfg-pull-none-drv-level-4-smt} { phandle = <0x161>; };
&{/pinctrl/pcfg-pull-none-drv-level-5-smt} { phandle = <0x162>; };
&{/pinctrl/pcfg-output-high} { phandle = <0x163>; };
&{/pinctrl/pcfg-output-low} { phandle = <0x164>; };
&{/pinctrl/acodec/acodec-pins} { phandle = <0x165>; };
&{/pinctrl/audiopwm/audiopwm-lout} { phandle = <0x166>; };
&{/pinctrl/audiopwm/audiopwm-loutn} { phandle = <0x167>; };
&{/pinctrl/audiopwm/audiopwm-loutp} { phandle = <0x168>; };
&{/pinctrl/audiopwm/audiopwm-rout} { phandle = <0x169>; };
&{/pinctrl/audiopwm/audiopwm-routn} { phandle = <0x16a>; };
&{/pinctrl/audiopwm/audiopwm-routp} { phandle = <0x16b>; };
&{/pinctrl/bt656/bt656m0-pins} { phandle = <0x16c>; };
&{/pinctrl/bt656/bt656m1-pins} { phandle = <0x16d>; };
&{/pinctrl/bt1120/bt1120-pins} { phandle = <0x16e>; };
&{/pinctrl/cam/cam-clkout0} { phandle = <0x16f>; };
&{/pinctrl/cam/cam-clkout1} { phandle = <0x170>; };
&{/pinctrl/can0/can0m0-pins} { phandle = <0x171>; };
&{/pinctrl/can0/can0m1-pins} { phandle = <0x172>; };
&{/pinctrl/can1/can1m0-pins} { phandle = <0x173>; };
&{/pinctrl/can1/can1m1-pins} { phandle = <0x174>; };
&{/pinctrl/can2/can2m0-pins} { phandle = <0x175>; };
&{/pinctrl/can2/can2m1-pins} { phandle = <0x176>; };
&{/pinctrl/cif/cif-clk} { phandle = <0x177>; };
&{/pinctrl/cif/cif-dvp-clk} { phandle = <0x178>; };
&{/pinctrl/cif/cif-dvp-bus16} { phandle = <0x179>; };
&{/pinctrl/cif/cif-dvp-bus8} { phandle = <0x17a>; };
&{/pinctrl/clk32k/clk32k-in} { phandle = <0x17b>; };
&{/pinctrl/clk32k/clk32k-out0} { phandle = <0xe>; };
&{/pinctrl/clk32k/clk32k-out1} { phandle = <0x17c>; };
&{/pinctrl/cpu/cpu-pins} { phandle = <0x17d>; };
&{/pinctrl/ebc/ebc-extern} { phandle = <0x17e>; };
&{/pinctrl/ebc/ebc-pins} { phandle = <0x17f>; };
&{/pinctrl/edpdp/edpdpm0-pins} { phandle = <0x180>; };
&{/pinctrl/edpdp/edpdpm1-pins} { phandle = <0x181>; };
&{/pinctrl/emmc/emmc-rstnout} { phandle = <0x6e>; };
&{/pinctrl/emmc/emmc-bus8} { phandle = <0x6a>; };
&{/pinctrl/emmc/emmc-clk} { phandle = <0x6b>; };
&{/pinctrl/emmc/emmc-cmd} { phandle = <0x6c>; };
&{/pinctrl/emmc/emmc-datastrobe} { phandle = <0x6d>; };
&{/pinctrl/eth0/eth0-pins} { phandle = <0x182>; };
&{/pinctrl/eth1/eth1m0-pins} { phandle = <0x183>; };
&{/pinctrl/eth1/eth1m1-pins} { phandle = <0x184>; };
&{/pinctrl/flash/flash-pins} { phandle = <0x185>; };
&{/pinctrl/fspi/fspi-pins} { phandle = <0x69>; };
&{/pinctrl/fspi/fspi-cs1} { phandle = <0x186>; };
&{/pinctrl/gmac0/gmac0-miim} { phandle = <0x187>; };
&{/pinctrl/gmac0/gmac0-clkinout} { phandle = <0x188>; };
&{/pinctrl/gmac0/gmac0-rx-er} { phandle = <0x189>; };
&{/pinctrl/gmac0/gmac0-rx-bus2} { phandle = <0x18a>; };
&{/pinctrl/gmac0/gmac0-tx-bus2} { phandle = <0x18b>; };
&{/pinctrl/gmac0/gmac0-rgmii-clk} { phandle = <0x18c>; };
&{/pinctrl/gmac0/gmac0-rgmii-bus} { phandle = <0x18d>; };
&{/pinctrl/gmac1/gmac1m0-miim} { phandle = <0x4b>; };
&{/pinctrl/gmac1/gmac1m0-clkinout} { phandle = <0x18e>; };
&{/pinctrl/gmac1/gmac1m0-rx-er} { phandle = <0x18f>; };
&{/pinctrl/gmac1/gmac1m0-rx-bus2} { phandle = <0x4d>; };
&{/pinctrl/gmac1/gmac1m0-tx-bus2} { phandle = <0x190>; };
&{/pinctrl/gmac1/gmac1m0-rgmii-clk} { phandle = <0x191>; };
&{/pinctrl/gmac1/gmac1m0-rgmii-bus} { phandle = <0x192>; };
&{/pinctrl/gmac1/gmac1m1-miim} { phandle = <0x193>; };
&{/pinctrl/gmac1/gmac1m1-clkinout} { phandle = <0x194>; };
&{/pinctrl/gmac1/gmac1m1-rx-er} { phandle = <0x195>; };
&{/pinctrl/gmac1/gmac1m1-rx-bus2} { phandle = <0x196>; };
&{/pinctrl/gmac1/gmac1m1-tx-bus2} { phandle = <0x197>; };
&{/pinctrl/gmac1/gmac1m1-rgmii-clk} { phandle = <0x198>; };
&{/pinctrl/gmac1/gmac1m1-rgmii-bus} { phandle = <0x199>; };
&{/pinctrl/gpu/gpu-pins} { phandle = <0x19a>; };
&{/pinctrl/hdmitx/hdmitxm0-cec} { phandle = <0x57>; };
&{/pinctrl/hdmitx/hdmitxm1-cec} { phandle = <0x19b>; };
&{/pinctrl/hdmitx/hdmitx-scl} { phandle = <0x55>; };
&{/pinctrl/hdmitx/hdmitx-sda} { phandle = <0x56>; };
&{/pinctrl/i2c0/i2c0-xfer} { phandle = <0x20>; };
&{/pinctrl/i2c1/i2c1-xfer} { phandle = <0x7f>; };
&{/pinctrl/i2c2/i2c2m0-xfer} { phandle = <0x80>; };
&{/pinctrl/i2c2/i2c2m1-xfer} { phandle = <0x19c>; };
&{/pinctrl/i2c3/i2c3m0-xfer} { phandle = <0x81>; };
&{/pinctrl/i2c3/i2c3m1-xfer} { phandle = <0x19d>; };
&{/pinctrl/i2c4/i2c4m0-xfer} { phandle = <0x19e>; };
&{/pinctrl/i2c4/i2c4m1-xfer} { phandle = <0x82>; };
&{/pinctrl/i2c5/i2c5m0-xfer} { phandle = <0x83>; };
&{/pinctrl/i2c5/i2c5m1-xfer} { phandle = <0x19f>; };
&{/pinctrl/i2s1/i2s1m0-lrckrx} { phandle = <0x1a0>; };
&{/pinctrl/i2s1/i2s1m0-lrcktx} { phandle = <0x71>; };
&{/pinctrl/i2s1/i2s1m0-mclk} { phandle = <0x24>; };
&{/pinctrl/i2s1/i2s1m0-sclkrx} { phandle = <0x1a1>; };
&{/pinctrl/i2s1/i2s1m0-sclktx} { phandle = <0x70>; };
&{/pinctrl/i2s1/i2s1m0-sdi0} { phandle = <0x72>; };
&{/pinctrl/i2s1/i2s1m0-sdi1} { phandle = <0x1a2>; };
&{/pinctrl/i2s1/i2s1m0-sdi2} { phandle = <0x1a3>; };
&{/pinctrl/i2s1/i2s1m0-sdi3} { phandle = <0x1a4>; };
&{/pinctrl/i2s1/i2s1m0-sdo0} { phandle = <0x73>; };
&{/pinctrl/i2s1/i2s1m0-sdo1} { phandle = <0x1a5>; };
&{/pinctrl/i2s1/i2s1m0-sdo2} { phandle = <0x1a6>; };
&{/pinctrl/i2s1/i2s1m0-sdo3} { phandle = <0x1a7>; };
&{/pinctrl/i2s1/i2s1m1-lrckrx} { phandle = <0x1a8>; };
&{/pinctrl/i2s1/i2s1m1-lrcktx} { phandle = <0x1a9>; };
&{/pinctrl/i2s1/i2s1m1-mclk} { phandle = <0x1aa>; };
&{/pinctrl/i2s1/i2s1m1-sclkrx} { phandle = <0x1ab>; };
&{/pinctrl/i2s1/i2s1m1-sclktx} { phandle = <0x1ac>; };
&{/pinctrl/i2s1/i2s1m1-sdi0} { phandle = <0x1ad>; };
&{/pinctrl/i2s1/i2s1m1-sdi1} { phandle = <0x1ae>; };
&{/pinctrl/i2s1/i2s1m1-sdi2} { phandle = <0x1af>; };
&{/pinctrl/i2s1/i2s1m1-sdi3} { phandle = <0x1b0>; };
&{/pinctrl/i2s1/i2s1m1-sdo0} { phandle = <0x1b1>; };
&{/pinctrl/i2s1/i2s1m1-sdo1} { phandle = <0x1b2>; };
&{/pinctrl/i2s1/i2s1m1-sdo2} { phandle = <0x1b3>; };
&{/pinctrl/i2s1/i2s1m1-sdo3} { phandle = <0x1b4>; };
&{/pinctrl/i2s1/i2s1m2-lrckrx} { phandle = <0x1b5>; };
&{/pinctrl/i2s1/i2s1m2-lrcktx} { phandle = <0x1b6>; };
&{/pinctrl/i2s1/i2s1m2-mclk} { phandle = <0x1b7>; };
&{/pinctrl/i2s1/i2s1m2-sclkrx} { phandle = <0x1b8>; };
&{/pinctrl/i2s1/i2s1m2-sclktx} { phandle = <0x1b9>; };
&{/pinctrl/i2s1/i2s1m2-sdi0} { phandle = <0x1ba>; };
&{/pinctrl/i2s1/i2s1m2-sdi1} { phandle = <0x1bb>; };
&{/pinctrl/i2s1/i2s1m2-sdi2} { phandle = <0x1bc>; };
&{/pinctrl/i2s1/i2s1m2-sdi3} { phandle = <0x1bd>; };
&{/pinctrl/i2s1/i2s1m2-sdo0} { phandle = <0x1be>; };
&{/pinctrl/i2s1/i2s1m2-sdo1} { phandle = <0x1bf>; };
&{/pinctrl/i2s1/i2s1m2-sdo2} { phandle = <0x1c0>; };
&{/pinctrl/i2s1/i2s1m2-sdo3} { phandle = <0x1c1>; };
&{/pinctrl/i2s2/i2s2m0-lrckrx} { phandle = <0x1c2>; };
&{/pinctrl/i2s2/i2s2m0-lrcktx} { phandle = <0x75>; };
&{/pinctrl/i2s2/i2s2m0-mclk} { phandle = <0x1c3>; };
&{/pinctrl/i2s2/i2s2m0-sclkrx} { phandle = <0x1c4>; };
&{/pinctrl/i2s2/i2s2m0-sclktx} { phandle = <0x74>; };
&{/pinctrl/i2s2/i2s2m0-sdi} { phandle = <0x76>; };
&{/pinctrl/i2s2/i2s2m0-sdo} { phandle = <0x77>; };
&{/pinctrl/i2s2/i2s2m1-lrckrx} { phandle = <0x1c5>; };
&{/pinctrl/i2s2/i2s2m1-lrcktx} { phandle = <0x1c6>; };
&{/pinctrl/i2s2/i2s2m1-mclk} { phandle = <0x1c7>; };
&{/pinctrl/i2s2/i2s2m1-sclkrx} { phandle = <0x1c8>; };
&{/pinctrl/i2s2/i2s2m1-sclktx} { phandle = <0x1c9>; };
&{/pinctrl/i2s2/i2s2m1-sdi} { phandle = <0x1ca>; };
&{/pinctrl/i2s2/i2s2m1-sdo} { phandle = <0x1cb>; };
&{/pinctrl/i2s3/i2s3m0-lrck} { phandle = <0x1cc>; };
&{/pinctrl/i2s3/i2s3m0-mclk} { phandle = <0x1cd>; };
&{/pinctrl/i2s3/i2s3m0-sclk} { phandle = <0x1ce>; };
&{/pinctrl/i2s3/i2s3m0-sdi} { phandle = <0x1cf>; };
&{/pinctrl/i2s3/i2s3m0-sdo} { phandle = <0x1d0>; };
&{/pinctrl/i2s3/i2s3m1-lrck} { phandle = <0x1d1>; };
&{/pinctrl/i2s3/i2s3m1-mclk} { phandle = <0x1d2>; };
&{/pinctrl/i2s3/i2s3m1-sclk} { phandle = <0x1d3>; };
&{/pinctrl/i2s3/i2s3m1-sdi} { phandle = <0x1d4>; };
&{/pinctrl/i2s3/i2s3m1-sdo} { phandle = <0x1d5>; };
&{/pinctrl/isp/isp-pins} { phandle = <0x1d6>; };
&{/pinctrl/jtag/jtag-pins} { phandle = <0x1d7>; };
&{/pinctrl/lcdc/lcdc-ctl} { phandle = <0x1d8>; };
&{/pinctrl/lcdc/lcdc-clock} { phandle = <0x1d9>; };
&{/pinctrl/lcdc/lcdc-data16} { phandle = <0x1da>; };
&{/pinctrl/lcdc/lcdc-data18} { phandle = <0x1db>; };
&{/pinctrl/mcu/mcu-pins} { phandle = <0x1dc>; };
&{/pinctrl/npu/npu-pins} { phandle = <0x1dd>; };
&{/pinctrl/pcie20/pcie20m0-pins} { phandle = <0x1de>; };
&{/pinctrl/pcie20/pcie20m1-pins} { phandle = <0x1df>; };
&{/pinctrl/pcie20/pcie20m2-pins} { phandle = <0x1e0>; };
&{/pinctrl/pcie20/pcie20-buttonrstn} { phandle = <0x1e1>; };
&{/pinctrl/pcie30x1/pcie30x1m0-pins} { phandle = <0x1e2>; };
&{/pinctrl/pcie30x1/pcie30x1m1-pins} { phandle = <0x1e3>; };
&{/pinctrl/pcie30x1/pcie30x1m2-pins} { phandle = <0x1e4>; };
&{/pinctrl/pcie30x1/pcie30x1-buttonrstn} { phandle = <0x1e5>; };
&{/pinctrl/pcie30x2/pcie30x2m0-pins} { phandle = <0x1e6>; };
&{/pinctrl/pcie30x2/pcie30x2m1-pins} { phandle = <0x1e7>; };
&{/pinctrl/pcie30x2/pcie30x2m2-pins} { phandle = <0x1e8>; };
&{/pinctrl/pcie30x2/pcie30x2-buttonrstn} { phandle = <0x1e9>; };
&{/pinctrl/pdm/pdmm0-clk} { phandle = <0x78>; };
&{/pinctrl/pdm/pdmm0-clk1} { phandle = <0x79>; };
&{/pinctrl/pdm/pdmm0-sdi0} { phandle = <0x7a>; };
&{/pinctrl/pdm/pdmm0-sdi1} { phandle = <0x7b>; };
&{/pinctrl/pdm/pdmm0-sdi2} { phandle = <0x7c>; };
&{/pinctrl/pdm/pdmm0-sdi3} { phandle = <0x7d>; };
&{/pinctrl/pdm/pdmm1-clk} { phandle = <0x1ea>; };
&{/pinctrl/pdm/pdmm1-clk1} { phandle = <0x1eb>; };
&{/pinctrl/pdm/pdmm1-sdi0} { phandle = <0x1ec>; };
&{/pinctrl/pdm/pdmm1-sdi1} { phandle = <0x1ed>; };
&{/pinctrl/pdm/pdmm1-sdi2} { phandle = <0x1ee>; };
&{/pinctrl/pdm/pdmm1-sdi3} { phandle = <0x1ef>; };
&{/pinctrl/pdm/pdmm2-clk1} { phandle = <0x1f0>; };
&{/pinctrl/pdm/pdmm2-sdi0} { phandle = <0x1f1>; };
&{/pinctrl/pdm/pdmm2-sdi1} { phandle = <0x1f2>; };
&{/pinctrl/pdm/pdmm2-sdi2} { phandle = <0x1f3>; };
&{/pinctrl/pdm/pdmm2-sdi3} { phandle = <0x1f4>; };
&{/pinctrl/pmic/pmic-pins} { phandle = <0x1f5>; };
&{/pinctrl/pmic/pmic-int} { phandle = <0x23>; };
&{/pinctrl/pmu/pmu-pins} { phandle = <0x1f6>; };
&{/pinctrl/pwm0/pwm0m0-pins} { phandle = <0x28>; };
&{/pinctrl/pwm0/pwm0m1-pins} { phandle = <0x1f7>; };
&{/pinctrl/pwm1/pwm1m0-pins} { phandle = <0x29>; };
&{/pinctrl/pwm1/pwm1m1-pins} { phandle = <0x1f8>; };
&{/pinctrl/pwm2/pwm2m0-pins} { phandle = <0x2a>; };
&{/pinctrl/pwm2/pwm2m1-pins} { phandle = <0x1f9>; };
&{/pinctrl/pwm3/pwm3-pins} { phandle = <0x2b>; };
&{/pinctrl/pwm4/pwm4-pins} { phandle = <0xa0>; };
&{/pinctrl/pwm5/pwm5-pins} { phandle = <0xa1>; };
&{/pinctrl/pwm6/pwm6-pins} { phandle = <0xa2>; };
&{/pinctrl/pwm7/pwm7-pins} { phandle = <0xa3>; };
&{/pinctrl/pwm8/pwm8m0-pins} { phandle = <0xa4>; };
&{/pinctrl/pwm8/pwm8m1-pins} { phandle = <0x1fa>; };
&{/pinctrl/pwm9/pwm9m0-pins} { phandle = <0xa5>; };
&{/pinctrl/pwm9/pwm9m1-pins} { phandle = <0x1fb>; };
&{/pinctrl/pwm10/pwm10m0-pins} { phandle = <0xa6>; };
&{/pinctrl/pwm10/pwm10m1-pins} { phandle = <0x1fc>; };
&{/pinctrl/pwm11/pwm11m0-pins} { phandle = <0xa7>; };
&{/pinctrl/pwm11/pwm11m1-pins} { phandle = <0x1fd>; };
&{/pinctrl/pwm12/pwm12m0-pins} { phandle = <0xa8>; };
&{/pinctrl/pwm12/pwm12m1-pins} { phandle = <0x1fe>; };
&{/pinctrl/pwm13/pwm13m0-pins} { phandle = <0xa9>; };
&{/pinctrl/pwm13/pwm13m1-pins} { phandle = <0x1ff>; };
&{/pinctrl/pwm14/pwm14m0-pins} { phandle = <0xaa>; };
&{/pinctrl/pwm14/pwm14m1-pins} { phandle = <0x200>; };
&{/pinctrl/pwm15/pwm15m0-pins} { phandle = <0xab>; };
&{/pinctrl/pwm15/pwm15m1-pins} { phandle = <0x201>; };
&{/pinctrl/refclk/refclk-pins} { phandle = <0x202>; };
&{/pinctrl/sata/sata-pins} { phandle = <0x203>; };
&{/pinctrl/sata0/sata0-pins} { phandle = <0x204>; };
&{/pinctrl/sata1/sata1-pins} { phandle = <0x205>; };
&{/pinctrl/sata2/sata2-pins} { phandle = <0x206>; };
&{/pinctrl/scr/scr-pins} { phandle = <0x207>; };
&{/pinctrl/sdmmc0/sdmmc0-bus4} { phandle = <0x5f>; };
&{/pinctrl/sdmmc0/sdmmc0-clk} { phandle = <0x60>; };
&{/pinctrl/sdmmc0/sdmmc0-cmd} { phandle = <0x61>; };
&{/pinctrl/sdmmc0/sdmmc0-det} { phandle = <0x62>; };
&{/pinctrl/sdmmc0/sdmmc0-pwren} { phandle = <0x208>; };
&{/pinctrl/sdmmc1/sdmmc1-bus4} { phandle = <0x65>; };
&{/pinctrl/sdmmc1/sdmmc1-clk} { phandle = <0x67>; };
&{/pinctrl/sdmmc1/sdmmc1-cmd} { phandle = <0x66>; };
&{/pinctrl/sdmmc1/sdmmc1-det} { phandle = <0x209>; };
&{/pinctrl/sdmmc1/sdmmc1-pwren} { phandle = <0x20a>; };
&{/pinctrl/sdmmc2/sdmmc2m0-bus4} { phandle = <0x20b>; };
&{/pinctrl/sdmmc2/sdmmc2m0-clk} { phandle = <0x20c>; };
&{/pinctrl/sdmmc2/sdmmc2m0-cmd} { phandle = <0x20d>; };
&{/pinctrl/sdmmc2/sdmmc2m0-det} { phandle = <0x20e>; };
&{/pinctrl/sdmmc2/sdmmc2m0-pwren} { phandle = <0x20f>; };
&{/pinctrl/sdmmc2/sdmmc2m1-bus4} { phandle = <0x210>; };
&{/pinctrl/sdmmc2/sdmmc2m1-clk} { phandle = <0x211>; };
&{/pinctrl/sdmmc2/sdmmc2m1-cmd} { phandle = <0x212>; };
&{/pinctrl/sdmmc2/sdmmc2m1-det} { phandle = <0x213>; };
&{/pinctrl/sdmmc2/sdmmc2m1-pwren} { phandle = <0x214>; };
&{/pinctrl/spdif/spdifm0-tx} { phandle = <0x7e>; };
&{/pinctrl/spdif/spdifm1-tx} { phandle = <0x215>; };
&{/pinctrl/spdif/spdifm2-tx} { phandle = <0x216>; };
&{/pinctrl/spi0/spi0m0-pins} { phandle = <0x86>; };
&{/pinctrl/spi0/spi0m0-cs0} { phandle = <0x84>; };
&{/pinctrl/spi0/spi0m0-cs1} { phandle = <0x85>; };
&{/pinctrl/spi0/spi0m1-pins} { phandle = <0x217>; };
&{/pinctrl/spi0/spi0m1-cs0} { phandle = <0x218>; };
&{/pinctrl/spi1/spi1m0-pins} { phandle = <0x89>; };
&{/pinctrl/spi1/spi1m0-cs0} { phandle = <0x87>; };
&{/pinctrl/spi1/spi1m0-cs1} { phandle = <0x88>; };
&{/pinctrl/spi1/spi1m1-pins} { phandle = <0x219>; };
&{/pinctrl/spi1/spi1m1-cs0} { phandle = <0x21a>; };
&{/pinctrl/spi2/spi2m0-pins} { phandle = <0x8c>; };
&{/pinctrl/spi2/spi2m0-cs0} { phandle = <0x8a>; };
&{/pinctrl/spi2/spi2m0-cs1} { phandle = <0x8b>; };
&{/pinctrl/spi2/spi2m1-pins} { phandle = <0x21b>; };
&{/pinctrl/spi2/spi2m1-cs0} { phandle = <0x21c>; };
&{/pinctrl/spi2/spi2m1-cs1} { phandle = <0x21d>; };
&{/pinctrl/spi3/spi3m0-pins} { phandle = <0x8f>; };
&{/pinctrl/spi3/spi3m0-cs0} { phandle = <0x8d>; };
&{/pinctrl/spi3/spi3m0-cs1} { phandle = <0x8e>; };
&{/pinctrl/spi3/spi3m1-pins} { phandle = <0x21e>; };
&{/pinctrl/spi3/spi3m1-cs0} { phandle = <0x21f>; };
&{/pinctrl/spi3/spi3m1-cs1} { phandle = <0x220>; };
&{/pinctrl/tsadc/tsadcm0-shut} { phandle = <0x221>; };
&{/pinctrl/tsadc/tsadcm1-shut} { phandle = <0x222>; };
&{/pinctrl/tsadc/tsadc-shutorg} { phandle = <0x9d>; };
&{/pinctrl/tsadc/tsadc-pin} { phandle = <0x9e>; };
&{/pinctrl/uart0/uart0-xfer} { phandle = <0x27>; };
&{/pinctrl/uart0/uart0-ctsn} { phandle = <0x223>; };
&{/pinctrl/uart0/uart0-rtsn} { phandle = <0x224>; };
&{/pinctrl/uart1/uart1m0-xfer} { phandle = <0x90>; };
&{/pinctrl/uart1/uart1m0-ctsn} { phandle = <0x225>; };
&{/pinctrl/uart1/uart1m0-rtsn} { phandle = <0x226>; };
&{/pinctrl/uart1/uart1m1-xfer} { phandle = <0x227>; };
&{/pinctrl/uart1/uart1m1-ctsn} { phandle = <0x228>; };
&{/pinctrl/uart1/uart1m1-rtsn} { phandle = <0x229>; };
&{/pinctrl/uart2/uart2m0-xfer} { phandle = <0x91>; };
&{/pinctrl/uart2/uart2m1-xfer} { phandle = <0x22a>; };
&{/pinctrl/uart3/uart3m0-xfer} { phandle = <0x92>; };
&{/pinctrl/uart3/uart3m0-ctsn} { phandle = <0x22b>; };
&{/pinctrl/uart3/uart3m0-rtsn} { phandle = <0x22c>; };
&{/pinctrl/uart3/uart3m1-xfer} { phandle = <0x22d>; };
&{/pinctrl/uart4/uart4m0-xfer} { phandle = <0x93>; };
&{/pinctrl/uart4/uart4m0-ctsn} { phandle = <0x22e>; };
&{/pinctrl/uart4/uart4m0-rtsn} { phandle = <0x22f>; };
&{/pinctrl/uart4/uart4m1-xfer} { phandle = <0x230>; };
&{/pinctrl/uart5/uart5m0-xfer} { phandle = <0x231>; };
&{/pinctrl/uart5/uart5m0-ctsn} { phandle = <0x232>; };
&{/pinctrl/uart5/uart5m0-rtsn} { phandle = <0x233>; };
&{/pinctrl/uart5/uart5m1-xfer} { phandle = <0x94>; };
&{/pinctrl/uart6/uart6m0-xfer} { phandle = <0x95>; };
&{/pinctrl/uart6/uart6m0-ctsn} { phandle = <0x234>; };
&{/pinctrl/uart6/uart6m0-rtsn} { phandle = <0x235>; };
&{/pinctrl/uart6/uart6m1-xfer} { phandle = <0x236>; };
&{/pinctrl/uart7/uart7m0-xfer} { phandle = <0x237>; };
&{/pinctrl/uart7/uart7m0-ctsn} { phandle = <0x238>; };
&{/pinctrl/uart7/uart7m0-rtsn} { phandle = <0x239>; };
&{/pinctrl/uart7/uart7m1-xfer} { phandle = <0x23a>; };
&{/pinctrl/uart7/uart7m2-xfer} { phandle = <0x96>; };
&{/pinctrl/uart8/uart8m0-xfer} { phandle = <0x97>; };
&{/pinctrl/uart8/uart8m0-ctsn} { phandle = <0x23b>; };
&{/pinctrl/uart8/uart8m0-rtsn} { phandle = <0x23c>; };
&{/pinctrl/uart8/uart8m1-xfer} { phandle = <0x23d>; };
&{/pinctrl/uart9/uart9m0-xfer} { phandle = <0x23e>; };
&{/pinctrl/uart9/uart9m0-ctsn} { phandle = <0x23f>; };
&{/pinctrl/uart9/uart9m0-rtsn} { phandle = <0x240>; };
&{/pinctrl/uart9/uart9m1-xfer} { phandle = <0x241>; };
&{/pinctrl/uart9/uart9m2-xfer} { phandle = <0x98>; };
&{/pinctrl/vop/vopm0-pins} { phandle = <0x242>; };
&{/pinctrl/vop/vopm1-pins} { phandle = <0x243>; };
&{/pinctrl/spi0-hs/spi0m0-pins} { phandle = <0x244>; };
&{/pinctrl/spi0-hs/spi0m0-cs0} { phandle = <0x245>; };
&{/pinctrl/spi0-hs/spi0m0-cs1} { phandle = <0x246>; };
&{/pinctrl/spi0-hs/spi0m1-pins} { phandle = <0x247>; };
&{/pinctrl/spi0-hs/spi0m1-cs0} { phandle = <0x248>; };
&{/pinctrl/spi1-hs/spi1m0-pins} { phandle = <0x249>; };
&{/pinctrl/spi1-hs/spi1m0-cs0} { phandle = <0x24a>; };
&{/pinctrl/spi1-hs/spi1m0-cs1} { phandle = <0x24b>; };
&{/pinctrl/spi1-hs/spi1m1-pins} { phandle = <0x24c>; };
&{/pinctrl/spi1-hs/spi1m1-cs0} { phandle = <0x24d>; };
&{/pinctrl/spi2-hs/spi2m0-pins} { phandle = <0x24e>; };
&{/pinctrl/spi2-hs/spi2m0-cs0} { phandle = <0x24f>; };
&{/pinctrl/spi2-hs/spi2m0-cs1} { phandle = <0x250>; };
&{/pinctrl/spi2-hs/spi2m1-pins} { phandle = <0x251>; };
&{/pinctrl/spi2-hs/spi2m1-cs0} { phandle = <0x252>; };
&{/pinctrl/spi2-hs/spi2m1-cs1} { phandle = <0x253>; };
&{/pinctrl/spi3-hs/spi3m0-pins} { phandle = <0x254>; };
&{/pinctrl/spi3-hs/spi3m0-cs0} { phandle = <0x255>; };
&{/pinctrl/spi3-hs/spi3m0-cs1} { phandle = <0x256>; };
&{/pinctrl/spi3-hs/spi3m1-pins} { phandle = <0x257>; };
&{/pinctrl/spi3-hs/spi3m1-cs0} { phandle = <0x258>; };
&{/pinctrl/spi3-hs/spi3m1-cs1} { phandle = <0x259>; };
&{/pinctrl/gmac-txd-level3/gmac0-tx-bus2-level3} { phandle = <0x25a>; };
&{/pinctrl/gmac-txd-level3/gmac0-rgmii-bus-level3} { phandle = <0x25b>; };
&{/pinctrl/gmac-txd-level3/gmac1m0-tx-bus2-level3} { phandle = <0x4c>; };
&{/pinctrl/gmac-txd-level3/gmac1m0-rgmii-bus-level3} { phandle = <0x4f>; };
&{/pinctrl/gmac-txd-level3/gmac1m1-tx-bus2-level3} { phandle = <0x25c>; };
&{/pinctrl/gmac-txd-level3/gmac1m1-rgmii-bus-level3} { phandle = <0x25d>; };
&{/pinctrl/gmac-txc-level2/gmac0-rgmii-clk-level2} { phandle = <0x25e>; };
&{/pinctrl/gmac-txc-level2/gmac1m0-rgmii-clk-level2} { phandle = <0x4e>; };
&{/pinctrl/gmac-txc-level2/gmac1m1-rgmii-clk-level2} { phandle = <0x25f>; };
&{/pinctrl/audio/hp-det} { phandle = <0xbe>; };
&{/pinctrl/audio/speaker-enable} { phandle = <0xc2>; };
&{/pinctrl/leds/work-led-pin} { phandle = <0xbd>; };
&{/pinctrl/sdcard/vcc-sd-en} { phandle = <0xc8>; };
&{/pinctrl/sdio-pwrseq/wifi-enable-h} { phandle = <0xc4>; };
&{/pinctrl/usb/vcc5v0-host-en} { phandle = <0xc6>; };
&{/pinctrl/usb/vcc5v0-otg-en} { phandle = <0xc7>; };
&{/opp-table-0} { phandle = <0x4>; };
&{/opp-table-1} { phandle = <0x43>; };
&{/regulator-12v-dcin} { phandle = <0xc5>; };
&{/hdmi-connector} { phandle = <0x260>; };
&{/hdmi-connector/port/endpoint} { phandle = <0x5b>; };
&{/rk809-sound} { phandle = <0x261>; };
&{/audio-amplifier} { phandle = <0xbf>; };
&{/sdio-pwrseq} { phandle = <0x64>; };
&{/regulator-wlan-32k} { phandle = <0x68>; };
&{/regulator-3v3-sys} { phandle = <0x25>; };
&{/regulator-5v0-sys} { phandle = <0x21>; };
&{/regulator-5v0-usb-host} { phandle = <0xb0>; };
&{/regulator-5v0-usb-otg} { phandle = <0xb1>; };
&{/regulator-3v3-sd} { phandle = <0x63>; };
&{/npu-opp-table} { phandle = <0x266>; };
&{/otp@fe38c000/npu-leakage@1c} { phandle = <0x268>; };
&{/otp@fe38c000/core-pvtm@2a} { phandle = <0x269>; };
&{/otp@fe38c000/mbist-vmin@9} { phandle = <0x26a>; };
&{/otp@fe38c000/npu-opp-info@42} { phandle = <0x26b>; };
&{/otp@fe38c000/specification-serial-number@7} { phandle = <0x26c>; };
&{/otp@fe38c000/remark-spec-serial-number@56} { phandle = <0x26d>; };
&{/binman} { phandle = <0x262>; };
&{/binman/template-1} { phandle = <0xc9>; };
&{/dmc} { phandle = <0x263>; };
&{/nvmem@fe38c000} { phandle = <0x264>; };
&{/nvmem@fe38c000/id@a} { phandle = <0x265>; };
